## buildroot/package/es_common/Config.in
```kconfig
config BR2_PACKAGE_ES_COMMON
	bool "embeded system common lib"
	help
	  the embeded system common lib is porting from linux kernel
	  what could support efficent common data structure and stl in C
	  Language in Embeded system in all machine platform
```
